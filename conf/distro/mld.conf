## conf/distro/mld.conf
```bitbake
DISTRO = "mld"
DISTRO_NAME = "MLD (MiniDVBLinux)"
DISTRO_VERSION = "6.0"
DISTRO_CODENAME = "dunfell"

MAINTAINER = "Claus Muus <mld@clausmuus.de>"

TARGET_VENDOR = "-mld"

LOCALCONF_VERSION = "1"

DISTRO_VERSION[vardepsexclude] = "DATE"
SDK_VERSION[vardepsexclude] = "DATE"
```

## conf/layer.conf
```bitbake
# We have a conf and classes directory, add to BBPATH
BBPATH =. "${LAYERDIR}:"

# We have recipes-* directories, add to BBFILES
BBFILES += "${LAYERDIR}/recipes-*/*/*.bb \
            ${LAYERDIR}/recipes-*/*/*.bbappend"

BBFILE_COLLECTIONS += "meta-mld"
BBFILE_PATTERN_meta-mld = "^${LAYERDIR}/"
BBFILE_PRIORITY_meta-mld = "5"

LAYERSERIES_COMPAT_meta-mld = "dunfell gatesgarth honister hardknott"
LAYERVERSION_mld = "3"
```
